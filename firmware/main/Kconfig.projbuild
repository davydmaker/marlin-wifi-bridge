## firmware/main/Kconfig.projbuild
```kconfig
menu "Marlin WiFi Bridge Configuration"

    config WIFI_MAX_RETRY
        int "WiFi max reconnect retries"
        default 10
        help
            Maximum number of reconnect attempts before reboot.

    config MARLIN_BAUD_RATE
        int "Marlin serial baud rate"
        default 115200
        help
            Baud rate for communication with the printer.

    config POLL_TEMP_INTERVAL_MS
        int "Temperature polling interval (ms)"
        default 2000

    config POLL_POSITION_INTERVAL_MS
        int "Position polling interval (ms)"
        default 3000

    config POLL_PROGRESS_INTERVAL_MS
        int "Print progress polling interval (ms)"
        default 5000

endmenu
```

## firmware/sdkconfig.defaults
```kconfig
CONFIG_IDF_TARGET="esp32s3"

CONFIG_USB_OTG_SUPPORTED=y
CONFIG_USB_HOST_CONTROL_TRANSFER_MAX_SIZE=1024
CONFIG_USB_HOST_HW_BUFFER_BIAS_BALANCED=y

CONFIG_FREERTOS_HZ=1000
CONFIG_FREERTOS_TIMER_TASK_STACK_DEPTH=3072
CONFIG_FREERTOS_USE_TRACE_FACILITY=y

CONFIG_ESP_WIFI_STA_DISCONNECTED_PM_ENABLE=n

CONFIG_LWIP_MAX_SOCKETS=8
CONFIG_LWIP_SO_RCVBUF=y

CONFIG_HTTPD_MAX_REQ_HDR_LEN=1024
CONFIG_HTTPD_MAX_URI_LEN=512
CONFIG_HTTPD_WS_SUPPORT=y

CONFIG_LOG_DEFAULT_LEVEL_INFO=y
CONFIG_LOG_MAXIMUM_LEVEL_DEBUG=y

CONFIG_PARTITION_TABLE_CUSTOM=y
CONFIG_PARTITION_TABLE_CUSTOM_FILENAME="partitions.csv"

CONFIG_LWIP_SNTP_MAX_SERVERS=2

CONFIG_ESP_TASK_WDT_TIMEOUT_S=10
CONFIG_ESP_TASK_WDT_EN=y

CONFIG_ESPTOOLPY_FLASHSIZE_8MB=y
CONFIG_ESPTOOLPY_FLASHMODE_QIO=y
```
